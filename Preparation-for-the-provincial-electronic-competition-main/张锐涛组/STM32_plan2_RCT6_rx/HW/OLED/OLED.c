#include "OLED.h"
#include "stm32f10x_conf.h"
#include "SysTick.h"

/* 引脚: DIN=PB15, RES=PB14, SCK=PB13, CS=PB12, DC=PC3 */

#define OLED_CS_L()   GPIO_ResetBits(GPIOB, GPIO_Pin_12)
#define OLED_CS_H()   GPIO_SetBits(GPIOB, GPIO_Pin_12)
#define OLED_DC_L()   GPIO_ResetBits(GPIOC, GPIO_Pin_3)
#define OLED_DC_H()   GPIO_SetBits(GPIOC, GPIO_Pin_3)
#define OLED_RES_L()  GPIO_ResetBits(GPIOB, GPIO_Pin_14)
#define OLED_RES_H()  GPIO_SetBits(GPIOB, GPIO_Pin_14)

static u8 g_oled_buf[128][8];  /* 128x64 全帧缓冲 */

static void oled_spi_init(void)
{
    GPIO_InitTypeDef GPIO_InitStructure;
    SPI_InitTypeDef  SPI_InitStructure;

    RCC_APB2PeriphClockCmd(RCC_APB2Periph_GPIOB | RCC_APB2Periph_GPIOC, ENABLE);
    RCC_APB1PeriphClockCmd(RCC_APB1Periph_SPI2, ENABLE);

    /* PB13=SCK, PB15=MOSI */
    GPIO_InitStructure.GPIO_Pin   = GPIO_Pin_13 | GPIO_Pin_15;
    GPIO_InitStructure.GPIO_Speed = GPIO_Speed_50MHz;
    GPIO_InitStructure.GPIO_Mode  = GPIO_Mode_AF_PP;
    GPIO_Init(GPIOB, &GPIO_InitStructure);

    /* PB12=CS, PB14=RES */
    GPIO_InitStructure.GPIO_Pin   = GPIO_Pin_12 | GPIO_Pin_14;
    GPIO_InitStructure.GPIO_Speed = GPIO_Speed_50MHz;
    GPIO_InitStructure.GPIO_Mode  = GPIO_Mode_Out_PP;
    GPIO_Init(GPIOB, &GPIO_InitStructure);

    /* PC3=DC */
    GPIO_InitStructure.GPIO_Pin   = GPIO_Pin_3;
    GPIO_InitStructure.GPIO_Speed = GPIO_Speed_50MHz;
    GPIO_InitStructure.GPIO_Mode  = GPIO_Mode_Out_PP;
    GPIO_Init(GPIOC, &GPIO_InitStructure);

    SPI_InitStructure.SPI_Direction      = SPI_Direction_2Lines_FullDuplex;
    SPI_InitStructure.SPI_Mode           = SPI_Mode_Master;
    SPI_InitStructure.SPI_DataSize       = SPI_DataSize_8b;
    SPI_InitStructure.SPI_CPOL           = SPI_CPOL_Low;
    SPI_InitStructure.SPI_CPHA           = SPI_CPHA_1Edge;
    SPI_InitStructure.SPI_NSS            = SPI_NSS_Soft;
    SPI_InitStructure.SPI_BaudRatePrescaler = SPI_BaudRatePrescaler_8;
    SPI_InitStructure.SPI_FirstBit       = SPI_FirstBit_MSB;
    SPI_InitStructure.SPI_CRCPolynomial  = 7;
    SPI_Init(SPI2, &SPI_InitStructure);
    SPI_Cmd(SPI2, ENABLE);

    OLED_CS_H();
}

static void oled_spi_write(u8 d)
{
    volatile u32 timeout;
    while (SPI_I2S_GetFlagStatus(SPI2, SPI_I2S_FLAG_TXE) == RESET);
    SPI_I2S_SendData(SPI2, d);
    /* 等待移位寄存器完成, BSY在全双工模式下可靠 */
    timeout = 10000;
    while (SPI_I2S_GetFlagStatus(SPI2, SPI_I2S_FLAG_BSY) == SET) {
        if (--timeout == 0) break;
    }
    /* 读DR清除RXNE, 防止OVR */
    (void)SPI2->DR;
}

static void oled_write_cmd(u8 cmd)
{
    OLED_DC_L();
    OLED_CS_L();
    oled_spi_write(cmd);
    OLED_CS_H();
    OLED_DC_H();
}

static void oled_write_data(u8 dat)
{
    OLED_DC_H();
    OLED_CS_L();
    oled_spi_write(dat);
    OLED_CS_H();
}

static void oled_set_pos(u8 x, u8 y)
{
    oled_write_cmd(0xB0 + y);
    oled_write_cmd(((x & 0xF0) >> 4) | 0x10);
    oled_write_cmd(x & 0x0F);
}

void OLED_Init(void)
{
    u8 i, j;
    oled_spi_init();

    OLED_RES_H();
    DelayNms(10);
    OLED_RES_L();
    DelayNms(10);
    OLED_RES_H();
    DelayNms(10);

    oled_write_cmd(0xAE); /* display off */
    oled_write_cmd(0x20); /* set memory addressing mode */
    oled_write_cmd(0x00); /* horizontal */
    oled_write_cmd(0xB0); /* set page start */
    oled_write_cmd(0xC8); /* COM scan direction */
    oled_write_cmd(0x00); /* set low column */
    oled_write_cmd(0x10); /* set high column */
    oled_write_cmd(0x40); /* set start line */
    oled_write_cmd(0x81); /* set contrast */
    oled_write_cmd(0xFF);
    oled_write_cmd(0xA1); /* segment remap */
    oled_write_cmd(0xA6); /* normal display */
    oled_write_cmd(0xA8); /* set multiplex ratio */
    oled_write_cmd(0x3F);
    oled_write_cmd(0xA4); /* output follows RAM */
    oled_write_cmd(0xD3); /* set display offset */
    oled_write_cmd(0x00);
    oled_write_cmd(0xD5); /* set oscillator */
    oled_write_cmd(0xF0);
    oled_write_cmd(0xD9); /* set pre-charge */
    oled_write_cmd(0x22);
    oled_write_cmd(0xDA); /* set COM pins */
    oled_write_cmd(0x12);
    oled_write_cmd(0xDB); /* set vcomh */
    oled_write_cmd(0x20);
    oled_write_cmd(0x8D); /* charge pump */
    oled_write_cmd(0x14);
    oled_write_cmd(0xAF); /* display on */

    for (i = 0; i < 128; i++)
        for (j = 0; j < 8; j++)
            g_oled_buf[i][j] = 0;
}

void OLED_Clear(void)
{
    u8 i, j;
    for (i = 0; i < 128; i++)
        for (j = 0; j < 8; j++)
            g_oled_buf[i][j] = 0;
}

static const u8 F6x8[][6] = {
    {0x00,0x00,0x00,0x00,0x00,0x00}, /* space */
    {0x00,0x00,0x5F,0x00,0x00,0x00}, /* ! */
    {0x00,0x07,0x00,0x07,0x00,0x00}, /* " */
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    {0x44,0x64,0x54,0x4C,0x44,0x00}, /* z */
};

void OLED_ShowString(u8 x, u8 y, const char *str)
{
    u8 c, i;
    while (*str) {
        c = *str - ' ';
        if (c > 90) c = 0;
        for (i = 0; i < 6 && x < 128; i++, x++)
            g_oled_buf[x][y] = F6x8[c][i];
        str++;
    }
}

static const u8 hex_chars[] = "0123456789ABCDEF";

void OLED_ShowHex(u8 x, u8 y, u8 *data, u8 len)
{
    u8 i;
    char buf[3];
    for (i = 0; i < len; i++) {
        buf[0] = hex_chars[data[i] >> 4];
        buf[1] = hex_chars[data[i] & 0x0F];
        buf[2] = '\0';
        OLED_ShowString(x + i * 12, y, buf);
    }
}

void OLED_ShowNum(u8 x, u8 y, u32 num, u8 digits)
{
    char buf[12];
    u8 i = 0;
    u8 start;
    if (num == 0) {
        buf[i++] = '0';
    } else {
        while (num && i < 10) {
            buf[i++] = (num % 10) + '0';
            num /= 10;
        }
    }
    while (i < digits) buf[i++] = '0';
    start = 0;
    while (start < i / 2) {
        char t = buf[start];
        buf[start] = buf[i - 1 - start];
        buf[i - 1 - start] = t;
        start++;
    }
    buf[i] = '\0';
    OLED_ShowString(x, y, buf);
}

void OLED_Refresh(void)
{
    u8 x, y;
    for (y = 0; y < 8; y++) {
        oled_set_pos(0, y);
        OLED_DC_H();
        OLED_CS_L();
        for (x = 0; x < 128; x++)
            oled_spi_write(g_oled_buf[x][y]);
        OLED_CS_H();
    }
}

/*********************************************************************************************************
* 模块名称：RCC.c
* 摘    要：RCC模块，包含时钟的配置函数
* 当前版本：1.1.0
* 作    者：SZLY(COPYRIGHT 2018 - 2020 SZLY. All rights reserved.)
* 创建日期：2020年01月01日
* 内    容：
* 注    意：
**********************************************************************************************************
* 取代版本：
* 作    者：
* 创建日期：
* 修改内容：去除RCC_DeInit()防重复复位; 增加PLL锁定超时保护
* 修改文件：
*********************************************************************************************************/

/*********************************************************************************************************
*                                              包含头文件
*********************************************************************************************************/
#include "RCC.h"
#include "stm32f10x_conf.h"

/*********************************************************************************************************
*                                              宏定义
*********************************************************************************************************/

/*********************************************************************************************************
*                                              枚举结构体定义
*********************************************************************************************************/

/*********************************************************************************************************
*                                              内部变量
*********************************************************************************************************/

/*********************************************************************************************************
*                                              内部函数声明
*********************************************************************************************************/
static  void  ConfigRCC(void);  //配置RCC

/*********************************************************************************************************
*                                              内部函数实现
*********************************************************************************************************/

/*********************************************************************************************************
* 函数名称：ConfigRCC
* 函数功能：配置RCC
* 输入参数：void
* 输出参数：void
* 返 回 值：void
* 创建日期：2018年01月01日
* 注    意：配置的时钟如下：
*              第0：外部晶振HSE          = 8MHz
*              第1：PLLCLK（PLL时钟）    = HSE*9   = 72MHz
*              第2：SYSCLK（系统时钟）   = PLLCLK  = 72MHz
*              第3：HCLK（AHB总线时钟）  = SYSCLK  = 72MHz
*              第4：PCLK1（APB1总线时钟）= HCLK/2  = 36MHz
*              第5：PCLK2（APB2总线时钟）= HCLK    = 72MHz
*              第6：ADCCLK（ADC时钟）    = PCLK2/4 = 72/4 = 18MHz
*
*            v1.1.0: 去除RCC_DeInit()避免重复复位时钟;
*                    PLL锁定和SYSCLK切换加入超时保护, 防止反复上电死锁
*********************************************************************************************************/
static void ConfigRCC(void)
{
  ErrorStatus HSEStartUpStatus;
  volatile u32 timeout;

  /* 不再调用 RCC_DeInit() — SystemInit() 在上电复位后已完成初始化 */
  /* 重复 DeInit() 再重新配置会导致反复上下电时时钟不稳 */

  RCC_HSEConfig(RCC_HSE_ON);                  //使能外部高速晶振

  HSEStartUpStatus = RCC_WaitForHSEStartUp(); //等待外部高速晶振稳定

  if(HSEStartUpStatus == SUCCESS)             //外部高速晶振成功稳定
  {
    FLASH_PrefetchBufferCmd(FLASH_PrefetchBuffer_Enable); //使能flash预取缓存区

    FLASH_SetLatency(FLASH_Latency_2);        //设置代码延时值，FLASH_Latency_2 2个延时周期

    RCC_HCLKConfig(RCC_SYSCLK_Div1);          //设置高速AHB时钟（HCLK），RCC_SYSCLK_Div1，HCLK = SYSCLK

    RCC_PCLK2Config(RCC_HCLK_Div1);           //设置高速APB2时钟（PCLK2），RCC_HCLK_Div1，PCLK2 = HCLK

    RCC_PCLK1Config(RCC_HCLK_Div2);           //设置低速APB1时钟（PCLK1），RCC_HCLK_Div2，PCLK1 = HCLK/2

    RCC_PLLConfig(RCC_PLLSource_HSE_Div1, RCC_PLLMul_9);//设置PLL时钟源及倍频系数，PLLCLK = 8MHz*9 = 72MHz

    RCC_PLLCmd(ENABLE);                       //使能PLL

    /* PLL锁定等待, 带超时保护, 防止晶振启动慢时死锁 */
    timeout = 0xFFFF;
    while(RCC_GetFlagStatus(RCC_FLAG_PLLRDY) == RESET)
    {
      if (--timeout == 0) break;
    }

    if (RCC_GetFlagStatus(RCC_FLAG_PLLRDY) != RESET)
    {
      /* 设置HSI/HSE/PLL为系统时钟 */
      RCC_SYSCLKConfig(RCC_SYSCLKSource_PLLCLK);         //设置锁相环输出为系统时钟

      /* 等待PLL成功用于系统时钟的时钟源, 带超时保护 */
      timeout = 0xFFFF;
      while(RCC_GetSYSCLKSource() != 0x08)
      {
        if (--timeout == 0) break;
      }
    }
    /* PLL锁相失败时, 系统保持在HSI(8MHz)运行, 不会死锁 */
  }
  /* HSE起振失败时, 系统保持在HSI(8MHz)运行, 不会死锁 */
}

/*********************************************************************************************************
*                                              API函数实现
*********************************************************************************************************/
/*********************************************************************************************************
* 函数名称：InitRCC
* 函数功能：初始化RCC模块
* 输入参数：void
* 输出参数：void
* 返 回 值：void
* 创建日期：2018年01月01日
* 注    意：
*********************************************************************************************************/
void InitRCC(void)
{
  ConfigRCC();  //配置RCC
}
